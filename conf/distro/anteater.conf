## conf/distro/anteater.conf
```bitbake
include conf/distro/poky.conf

DISTRO = "anteater"
DISTRO_NAME = "Anteater-Linux"
DISTRO_VERSION = "1.0"

MAINTAINER = "kimogi@kraev.me"

PREFERRED_VERSION:libgpiod = "2.%"

NETWORK_MANAGER = "networkmanager"

DISTRO_FEATURES:append = " systemd usrmerge"
DISTRO_FEATURES_BACKFILL_CONSIDERED:append = " sysvinit"
VIRTUAL-RUNTIME_init_manager = "systemd"
VIRTUAL-RUNTIME_initscripts = "systemd-compat-units"
ENABLE_UART = "1"

hostname:pn-base-files = "anteater"
INHERIT += "extrausers"
EXTRA_USERS_PARAMS = "usermod -p '\$1\$J4xg2t/S\$1GAP0.WQA0vdlqboSHo2L.' root;"
```

## conf/distro/basenode.conf
```bitbake
include conf/distro/poky.conf

DISTRO = "basenode"
DISTRO_NAME = "BaseNode-Linux"
DISTRO_VERSION = "1.0"
DISTRO_CODENAME = "AntEater"

MAINTAINER = "kimogi@kraev.me"

#PREFERRED_VERSION_libgpiod = "2.2.%"

NETWORK_MANAGER = "networkmanager"
DISTRO_FEATURES_append = " systemd"
DISTRO_FEATURES_BACKFILL_CONSIDERED += "sysvinit"
VIRTUAL-RUNTIME_init_manager = "systemd"
VIRTUAL-RUNTIME_initscripts = "systemd-compat-units"
ENABLE_UART = "1"

hostname_pn-base-files = "anteater"
```

## conf/distro/pipump.conf
```bitbake
include conf/distro/poky.conf

DISTRO = "pipump"
DISTRO_NAME = "PiPump-Linux"
DISTRO_VERSION = "1.0"
DISTRO_CODENAME = "AntEater"

MAINTAINER = "kimogi@kraev.me"

PREFERRED_VERSION_libgpiod = "1.4.%"

NETWORK_MANAGER = "networkmanager"
DISTRO_FEATURES_append = " systemd"
DISTRO_FEATURES_BACKFILL_CONSIDERED += "sysvinit"
VIRTUAL-RUNTIME_init_manager = "systemd"
VIRTUAL-RUNTIME_initscripts = "systemd-compat-units"
ENABLE_UART = "1"

hostname_pn-base-files = "anteater"
```

## conf/layer.conf
```bitbake
# We have a conf and classes directory, append to BBPATH
BBPATH .= ":${LAYERDIR}"

# We have a recipes directory containing .bb and .bbappend files, add to BBFILES
BBFILES += "${LAYERDIR}/recipes*/*/*.bb \
            ${LAYERDIR}/recipes*/*/*.bbappend"

BBFILE_COLLECTIONS += "anteater"
BBFILE_PATTERN_anteater := "^${LAYERDIR}/"
BBFILE_PRIORITY_anteater = "10"

LAYERSERIES_COMPAT_anteater = "scarthgap"
LAYERDEPENDS_anteater = "core"
```
